## components/app_cfg/Kconfig
```kconfig
menu "App Settings"
    config APP_AP_SSID_PREFIX
        string "Setup AP SSID prefix"
        default "ESP-SETUP-"

    config APP_AP_PASSWORD
        string "Setup AP password (>=8 chars; empty=open)"
        default "12345678"

    config APP_BUTTON_GPIO
        int "Setup/reset button GPIO"
        default 0

    config APP_BUTTON_LONG_MS
        int "Long-press duration to erase creds (ms)"
        default 3000
        range 500 10000
endmenu
menu "Network Posting (API Gateway / S3)"

config POST_URL
    string "POST endpoint URL"
    default "https://your-api-id.execute-api.your-region.amazonaws.com/prod/ingest"
    help
        Full HTTPS endpoint of API Gateway that invokes your Lambda → S3.

config POST_API_KEY
    string "POST API key (x-api-key header)"
    default ""
    help
        If your API Gateway uses an API key, put it here. Leave empty if not used.

config POST_PERIOD_SEC
    int "POST period (seconds)"
    default 300
    range 30 3600
    help
        How often to post sensor readings (seconds). Default 300 = 5 minutes.

endmenu
```

## components/net_post/Kconfig
```kconfig
menu "Application Configuration"

config APP_POST_URL
    string "S3 JSON URL (HTTPS)"
    default "https://example-bucket.s3.amazonaws.com/latest-command.json"
    help
        Full HTTPS URL to the S3 object containing the latest command JSON.
        Use a public object or a pre-signed URL for private buckets.

config APP_DEVICE_ID
    string "Device ID (unused by net_post; kept for compatibility)"
    default "device-01"
    help
        Retained for compatibility; ignored by S3 polling.

config APP_API_KEY
    string "API key (unused for S3; kept for compatibility)"
    default ""
    help
        Retained for compatibility; ignored by S3 polling.

config APP_POST_INTERVAL_SEC
    int "Polling interval (seconds)"
    range 1 86400
    default 3
    help
        How often to GET the S3 JSON. Minimum 1 second.

endmenu
```
